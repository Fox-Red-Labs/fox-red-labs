## am263p/zephyr/boards/ti/lp_am263p/Kconfig.lp_am263p
```kconfig
config BOARD_LP_AM263P
	select SOC_AM263P4_R5F0_0 if BOARD_LP_AM263P_AM263P4_R5F0_0
	select SOC_AM263P4_R5F0_1 if BOARD_LP_AM263P_AM263P4_R5F0_1
```

## am263p/zephyr/boards/ti/lp_am263p/board.yml
```yaml
board:
  name: lp_am263p
  full_name: TI LP-AM263P LaunchPad (Fox Red Labs out-of-tree port)
  vendor: ti
  socs:
  - name: am263p4
```

## am263p/zephyr/boards/ti/lp_am263p/lp_am263p_am263p4_r5f0_0_defconfig
```kconfig
CONFIG_XIP=n
CONFIG_SERIAL=y
CONFIG_CONSOLE=y
CONFIG_UART_CONSOLE=y
CONFIG_ARM_MPU=n
```

## am263p/zephyr/soc/ti/am26x/Kconfig
```kconfig
config SOC_SERIES_AM26X
	select ARM
	select CPU_CORTEX_R5
	select CPU_HAS_ARM_MPU
	select VFP_SP_D16
	select ARM_CUSTOM_INTERRUPT_CONTROLLER
	select TI_VIM
	select UART_NS16550_ACCESS_WORD_ONLY if UART_NS16550
	select SOC_EARLY_INIT_HOOK
```

## am62l-evm/zephyr/apps/core1-hello/Kconfig
```kconfig
mainmenu "core1-hello"
source "Kconfig.zephyr"

config FRL_RING_CONSOLE
	bool "Send printk to a 4 KB ring buffer in on-chip SRAM instead of a UART"
	help
	  Layout at FRL_RING_ADDR: u32 magic 0x52524C46, u32 head (bytes written, only grows),
	  u32 size of data area (4080), u32 reserved; data from +16. Byte i is at data[i % size].

config FRL_RING_ADDR
	hex "Physical address of the ring (top 4 KB of the Zephyr SRAM map)"
	default 0x70813000
```

## mspm0l1306/zephyr/boards/ti/lp_mspm0l1306/Kconfig
```kconfig
# SPDX-License-Identifier: Apache-2.0
# Board-specific options for the out-of-tree lp_mspm0l1306 board.

config BOARD_LP_MSPM0L1306_GPIO
	bool "GPIO driver with the MSPM0L1306 pin table (board-local copy)"
	default y
	depends on BOARD_LP_MSPM0L1306 && GPIO && DT_HAS_TI_MSPM0_GPIO_ENABLED
	select USE_MSPM0_DL_GPIO
	help
	  Zephyr 4.4.2's gpio_mspm0.c has one pin table for the whole MSPM0L series, the
	  80-pin MSPM0L222x one. It does not compile for the MSPM0L1306. This builds
	  gpio_mspm0_l1306.c from the board folder instead, with a 28-pin table.
```

## mspm0l1306/zephyr/boards/ti/lp_mspm0l1306/board.yml
```yaml
board:
  name: lp_mspm0l1306
  full_name: MSPM0L1306 LaunchPad (out of tree, Fox Red Labs)
  vendor: ti
  socs:
    - name: mspm0l1306
```

## portability/boosterpacks/zephyr/boards/shields/boostxl_audio/Kconfig.shield
```kconfig
# SPDX-License-Identifier: Apache-2.0

config SHIELD_BOOSTXL_AUDIO
	def_bool $(shields_list_contains,boostxl_audio)
```

## portability/boosterpacks/zephyr/boards/shields/boostxl_edumkii/Kconfig.shield
```kconfig
# SPDX-License-Identifier: Apache-2.0

config SHIELD_BOOSTXL_EDUMKII
	def_bool $(shields_list_contains,boostxl_edumkii)
```

## portability/boosterpacks/zephyr/boards/shields/boostxl_edumkii_gpiospi/Kconfig.shield
```kconfig
# SPDX-License-Identifier: Apache-2.0

config SHIELD_BOOSTXL_EDUMKII_GPIOSPI
	def_bool $(shields_list_contains,boostxl_edumkii_gpiospi)
```

## portability/boosterpacks/zephyr/boards/shields/boostxl_sharp128/Kconfig.shield
```kconfig
# SPDX-License-Identifier: Apache-2.0

config SHIELD_BOOSTXL_SHARP128
	def_bool $(shields_list_contains,boostxl_sharp128)
```
