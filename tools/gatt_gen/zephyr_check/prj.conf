## CMakeLists.txt
```
# Compile-and-link check for gatt_gen's Zephyr output. build.sh generates the services into the build folder.
cmake_minimum_required(VERSION 3.20.0)
find_package(Zephyr REQUIRED HINTS $ENV{ZEPHYR_BASE})
project(gatt_gen_check)
target_include_directories(app PRIVATE ${GEN_DIR})
target_sources(app PRIVATE src/main.c ${GEN_DIR}/blinky_service.c ${GEN_DIR}/bench_probe_service.c)
```

## prj.conf
```kconfig
CONFIG_BT=y
CONFIG_BT_PERIPHERAL=y
CONFIG_BT_DEVICE_NAME="Blinky FRL"
CONFIG_SERIAL=y
CONFIG_UART_INTERRUPT_DRIVEN=y
CONFIG_CONSOLE=n
CONFIG_UART_CONSOLE=n
# The mbedtls module is not in this workspace; the host then asks the controller for random numbers (stubbed in main.c)
CONFIG_BT_HOST_CRYPTO=n
```

## app.overlay
```dts
/* Compile check only: the Bluetooth host talks to an external controller over UART0 (H4). */
/ {
	chosen {
		zephyr,bt-hci = &bt_hci_uart;
	};
};
&uart0 {
	bt_hci_uart: bt_hci_uart {
		compatible = "zephyr,bt-hci-uart";
		status = "okay";
	};
};
```

## src/main.c
```c
#include <string.h>
#include <zephyr/kernel.h>
#include <zephyr/bluetooth/bluetooth.h>
#include "blinky_service.h"
#include "bench_probe_service.h"

static void changed(struct bt_conn *conn, uint8_t char_id, uint16_t len, const uint8_t *value)
{
	if (char_id == BLINKY_LED_ID && len == BLINKY_LED_LEN) {
		/* drive the LED from value[0] here */
	}
}

int main(void)
{
	uint8_t pressed = 1, cmd[BENCH_PROBE_COMMAND_LEN] = {0};
	uint16_t n = sizeof(cmd);

	bt_enable(NULL);
	blinky_service_init(changed);
	bench_probe_service_init(NULL);
	blinky_service_set_button(&pressed, sizeof(pressed));
	blinky_service_notify_button();
	bench_probe_service_get_command(cmd, &n);
	bench_probe_service_notify_reading();
	bench_probe_service_indicate_reading();
	bench_probe_service_indicate_alarm();
	return 0;
}

/* Link check only (this is not a usable random source): with host crypto off, the host expects the controller's random numbers. Not random. */
int bt_rand(void *buf, size_t len)
{
	memset(buf, 0x5a, len);
	return 0;
}
```
