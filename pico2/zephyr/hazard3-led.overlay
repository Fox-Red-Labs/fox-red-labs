/* The Zephyr 4.4.2 board file for rpi_pico2/rp2350a/hazard3 does not include ../common/rpi_pico-led.dtsi, which the
 * m33 board file does, so samples that use the led0 alias (blinky) do not compile. This overlay adds it. */
#include <zephyr/dt-bindings/gpio/gpio.h>
/ {
	leds {
		compatible = "gpio-leds";
		led0: led_0 {
			gpios = <&gpio0 25 GPIO_ACTIVE_HIGH>;
			label = "LED";
		};
	};
	aliases {
		led0 = &led0;
	};
};
