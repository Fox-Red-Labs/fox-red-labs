#include <stdio.h>
/*
 * Nordic phone-app services for the LP-EM-CC2340R5: the TI glue.
 *
 * Two services Nordic's phone apps look for, both generated by tools/gatt_gen
 * (target ti-f3) from the two JSON files in services/ and attached to TI's basic_ble example:
 *
 *   LED Button Service (nRF Blinky): LED characteristic -> red LED (DIO14),
 *   Button characteristic <- left button BTN-1 (DIO10), notified on press and release.
 *   Nordic UART Service (nRF Toolbox, Bluefruit Connect, Web Bluetooth terminals):
 *   every received line is echoed back on TX; "button" is sent on TX when the button is pressed.
 *
 * All stack calls run in the BLE application task. The button callback and the
 * retry clock run elsewhere and hop in with BLEAppUtil_invokeFunctionNoData.
 */
#include <string.h>
#include <ti/drivers/GPIO.h>
#include <ti/drivers/apps/Button.h>
#include <ti/drivers/dpl/ClockP.h>
#include "ti_drivers_config.h"
#include "ti_ble_config.h"
#include "app_main.h"
#include "ti/ble/app_util/menu/menu_module.h"
#include "led_button_service.h"
#include "nordic_uart_service.h"
#include "oled.h"
#include <stdlib.h>

#define LINE_MAX      120      /* longest echoed line; a longer one is sent in pieces */
#define TXQ_SIZE      512      /* bytes waiting for notifications */
#define ATT_OVERHEAD  3        /* ATT opcode and handle: a notification carries MTU - 3 bytes */
#define RETRY_MS      8        /* wait before offering the stack the next notification */

static uint8_t  lineBuf[LINE_MAX];
static uint16_t lineLen;
static uint8_t  txq[TXQ_SIZE];
static uint16_t txHead, txCount;
static uint16_t attMtu = 23;
static volatile uint8_t buttonDown;
static ClockP_Struct retryClock;
static ClockP_Handle retryHandle;
static Button_Handle buttonHandle;

/* "N:text" sets display line N (1..8); "cls" clears. Anything else is ignored. The line that
 * would be drawn is printed on the serial console, so the BLE half proves itself without a display. */
static void deskCommand(const uint8_t *b, uint16_t n)
{
    char cmdline[LINE_MAX + 1];
    uint16_t k = 0;
    while (n && (b[n - 1] == '\n' || b[n - 1] == '\r')) n--;
    if (n == 0) return;
    for (uint16_t i = 0; i < n && k < LINE_MAX; i++) cmdline[k++] = (char)b[i];
    cmdline[k] = 0;
    if (strcmp(cmdline, "cls") == 0)
    {
        Oled_clear();
        MenuModule_printf(APP_MENU_PROFILE_STATUS_LINE3, 0, "DRAW cls");
        return;
    }
    if (cmdline[0] >= '1' && cmdline[0] <= '8' && cmdline[1] == ':')
    {
        Oled_setLine((uint8_t)(cmdline[0] - '1'), cmdline + 2);
        MenuModule_printf(APP_MENU_PROFILE_STATUS_LINE3, 0, "DRAW %c:%.21s", cmdline[0], cmdline + 2);
    }
}

static void Nordic_pump(char *pData);

/* ---- UART service: queue, notify ---- */

static void txq_put(const uint8_t *p, uint16_t n)
{
    for (uint16_t i = 0; i < n && txCount < TXQ_SIZE; i++)
    {
        txq[(txHead + txCount) % TXQ_SIZE] = p[i];
        txCount++;
    }
}

/* Send what is queued, one notification of up to MTU-3 bytes at a time; if the stack
 * has no buffer free, come back after RETRY_MS. */
static void Nordic_pump(char *pData)
{
    (void)pData;
    uint8_t chunk[NORDIC_UART_TX_LEN];
    while (txCount > 0)
    {
        uint16_t n = attMtu - ATT_OVERHEAD;
        if (n > NORDIC_UART_TX_LEN) n = NORDIC_UART_TX_LEN;
        if (n > txCount) n = txCount;
        for (uint16_t i = 0; i < n; i++) chunk[i] = txq[(txHead + i) % TXQ_SIZE];
        NordicUartService_SetTx(chunk, n);
        bStatus_t st = NordicUartService_NotifyTx();
        if (st != SUCCESS)
        {
            ClockP_setTimeout(retryHandle, (RETRY_MS * 1000u) / ClockP_getSystemTickPeriod());
            ClockP_start(retryHandle);
            return;
        }
        txHead = (txHead + n) % TXQ_SIZE;
        txCount -= n;
    }
}

static void retryCb(uintptr_t arg)
{
    (void)arg;
    BLEAppUtil_invokeFunctionNoData(Nordic_pump);
}

static void sendText(const char *s)
{
    txq_put((const uint8_t *)s, (uint16_t)strlen(s));
    Nordic_pump(NULL);
}

/* A peer wrote to Rx (stack context). Collect bytes into a line; echo it when the line ends. */
static void uartChanged(uint16_t connHandle, uint8_t charId, uint16_t len, uint8_t *pValue)
{
    (void)connHandle;
    if (charId != NORDIC_UART_RX_ID) return;
    for (uint16_t i = 0; i < len; i++)
    {
        lineBuf[lineLen++] = pValue[i];
        if (pValue[i] == '\n' || pValue[i] == '\r' || lineLen == LINE_MAX)
        {
            txq_put(lineBuf, lineLen);
            deskCommand(lineBuf, lineLen);
            lineLen = 0;
        }
    }
    Nordic_pump(NULL);
}

/* ---- LED Button service ---- */

static void ledButtonChanged(uint16_t connHandle, uint8_t charId, uint16_t len, uint8_t *pValue)
{
    (void)connHandle; (void)len;
    if (charId == LED_BUTTON_LED_ID)
    {
        GPIO_write(CONFIG_GPIO_LED_RED, pValue[0] ? CONFIG_GPIO_LED_ON : CONFIG_GPIO_LED_OFF);
    }
}

/* In the BLE task: publish the button state to the phone. */
static void Nordic_button(char *pData)
{
    (void)pData;
    uint8_t v = buttonDown;
    LedButtonService_SetButton(&v, 1);
    LedButtonService_NotifyButton();
    if (v) sendText("button\n");
}

/* Button driver context: only note the state and hop. */
static void buttonCb(Button_Handle h, Button_EventMask ev)
{
    (void)h;
    if (ev & Button_EV_PRESSED)  buttonDown = 1;
    if (ev & Button_EV_RELEASED) buttonDown = 0;
    BLEAppUtil_invokeFunctionNoData(Nordic_button);
}

/* ---- link events ---- */

static void Nordic_gattEvent(uint32 event, BLEAppUtil_msgHdr_t *pMsgData)
{
    (void)event;
    gattMsgEvent_t *m = (gattMsgEvent_t *)pMsgData;
    if (m->method == ATT_MTU_UPDATED_EVENT)
    {
        attMtu = m->msg.mtuEvt.MTU;
        MenuModule_printf(APP_MENU_PROFILE_STATUS_LINE2, 0, "Nordic: ATT MTU %d", attMtu);
    }
}

static void Nordic_connEvent(uint32 event, BLEAppUtil_msgHdr_t *pMsgData)
{
    (void)pMsgData;
    if (event == BLEAPPUTIL_LINK_ESTABLISHED_EVENT || event == BLEAPPUTIL_LINK_TERMINATED_EVENT)
    {
        attMtu = 23;
        lineLen = 0;
        txCount = 0;
        Oled_setLine(7, event == BLEAPPUTIL_LINK_ESTABLISHED_EVENT ? "linked" : "waiting for a link");
        MenuModule_printf(APP_MENU_PROFILE_STATUS_LINE2, 0, "LINK %s", event == BLEAPPUTIL_LINK_ESTABLISHED_EVENT ? "up" : "down");
    }
}

static BLEAppUtil_EventHandler_t nordicGattHandler =
{
    .handlerType   = BLEAPPUTIL_GATT_TYPE,
    .pEventHandler = Nordic_gattEvent,
    .eventMask     = BLEAPPUTIL_ATT_MTU_UPDATED_EVENT
};

static BLEAppUtil_EventHandler_t nordicConnHandler =
{
    .handlerType   = BLEAPPUTIL_GAP_CONN_TYPE,
    .pEventHandler = Nordic_connEvent,
    .eventMask     = BLEAPPUTIL_LINK_ESTABLISHED_EVENT | BLEAPPUTIL_LINK_TERMINATED_EVENT
};

/* Called from App_StackInitDoneHandler in place of SimpleGatt_start(). */
bStatus_t Nordic_start(void)
{
    bStatus_t st = LedButtonService_AddService(INVALID_TASK_ID, ledButtonChanged);
    if (st != SUCCESS) return st;
    st = NordicUartService_AddService(INVALID_TASK_ID, uartChanged);
    if (st != SUCCESS) return st;

    GPIO_write(CONFIG_GPIO_LED_RED, CONFIG_GPIO_LED_OFF);
    bool oled = Oled_init();
    Oled_setLine(0, "FRL desk display");
    Oled_setLine(7, "waiting for a link");
    {   extern uint8_t oled_found_mask[16]; extern int oled_i2c_open_ok;
        char lst[64]; int n = 0; lst[0] = 0;
        for (int a = 0x08; a < 0x78 && n < 58; a++) if (oled_found_mask[a >> 3] & (1u << (a & 7))) n += snprintf(lst + n, sizeof lst - n, " %02X", a);
        MenuModule_printf(APP_MENU_PROFILE_STATUS_LINE4, 0, "OLED %s; i2c open %d; bus scan:%s", oled ? "found" : "not found", oled_i2c_open_ok, n ? lst : " none");
    }

    ClockP_Params cp;
    ClockP_Params_init(&cp);
    cp.period = 0;
    cp.startFlag = false;
    retryHandle = ClockP_construct(&retryClock, retryCb, (RETRY_MS * 1000u) / ClockP_getSystemTickPeriod(), &cp);

    Button_Params bp;
    Button_Params_init(&bp);
    bp.buttonEventMask = Button_EV_PRESSED | Button_EV_RELEASED;
    bp.buttonCallback = buttonCb;
    buttonHandle = Button_open(CONFIG_NORDIC_BTN_LEFT, &bp);

    BLEAppUtil_registerEventHandler(&nordicGattHandler);
    BLEAppUtil_registerEventHandler(&nordicConnHandler);
    MenuModule_printf(APP_MENU_PROFILE_STATUS_LINE, 0, "Nordic: LED Button Service and Nordic UART Service up");
    return SUCCESS;
}
