## CMakeLists.txt
```
# SPDX-License-Identifier: Apache-2.0
# Thread-Metric for the LP-MSPM0L1306 (4 KB RAM). The test sources are Zephyr's own, read in place from
# $ZEPHYR_BASE/tests/benchmarks/thread_metric/src. Only the porting layer is replaced (src/), because
# Zephyr's reserves 10 stacks of 1,024 bytes plus buffers, 14 KB in all.
# Choose the test with -DTM_TEST=basic|cooperative|preemptive|interrupt|interrupt_preemption|memory|message|synchronization
# Optional: -DTM_DURATION=<seconds> (default 30, the standard), -DTM_STACK=<bytes> (default 256 for the two five-thread tests, else 512),
#           -DTM_BASIC_ARRAY=<ulongs> (basic test only, default 256; Zephyr's 1024 alone is 4,096 bytes).
cmake_minimum_required(VERSION 3.20.0)
find_package(Zephyr REQUIRED HINTS $ENV{ZEPHYR_BASE})
project(thread_metric_l1306)

set(TM_SRC $ENV{ZEPHYR_BASE}/tests/benchmarks/thread_metric/src)
if(NOT DEFINED TM_TEST)
  message(FATAL_ERROR "Pass -DTM_TEST=<test name>")
endif()
if(NOT DEFINED TM_DURATION)
  set(TM_DURATION 30)
endif()
if(NOT DEFINED TM_STACK)
  # Five-thread tests get 256 bytes per stack, the others 512, so every test links in 4 KB.
  if(TM_TEST STREQUAL cooperative OR TM_TEST STREQUAL preemptive)
    set(TM_STACK 256)
  else()
    set(TM_STACK 512)
  endif()
endif()
if(NOT DEFINED TM_BASIC_ARRAY)
  set(TM_BASIC_ARRAY 256)
endif()

set(TM_FILE_basic                 tm_basic_processing_test.c)
set(TM_FILE_cooperative           tm_cooperative_scheduling_test.c)
set(TM_FILE_preemptive            tm_preemptive_scheduling_test.c)
set(TM_FILE_interrupt             tm_interrupt_processing_test.c)
set(TM_FILE_interrupt_preemption  tm_interrupt_preemption_processing_test.c)
set(TM_FILE_memory                tm_memory_allocation_test.c)
set(TM_FILE_message               tm_message_processing_test.c)
set(TM_FILE_synchronization       tm_synchronization_processing_test.c)
set(TM_THREADS_basic 1)
set(TM_THREADS_cooperative 5)
set(TM_THREADS_preemptive 5)
set(TM_THREADS_interrupt 1)
set(TM_THREADS_interrupt_preemption 2)
set(TM_THREADS_memory 1)
set(TM_THREADS_message 1)
set(TM_THREADS_synchronization 1)
if(NOT DEFINED TM_FILE_${TM_TEST})
  message(FATAL_ERROR "Unknown TM_TEST ${TM_TEST}")
endif()

set(TM_TEST_C ${TM_SRC}/${TM_FILE_${TM_TEST}})
if(TM_TEST STREQUAL basic)
  # Zephyr's basic test sums a 1,024-entry array (4,096 bytes of RAM, the whole chip). Build a copy
  # with a smaller array. The count per period is then NOT comparable with other chips' basic counts.
  file(READ ${TM_SRC}/${TM_FILE_basic} TM_BASIC_TEXT)
  string(REPLACE "1024" "${TM_BASIC_ARRAY}" TM_BASIC_TEXT "${TM_BASIC_TEXT}")
  file(WRITE ${CMAKE_CURRENT_BINARY_DIR}/tm_basic_small.c "${TM_BASIC_TEXT}")
  set(TM_TEST_C ${CMAKE_CURRENT_BINARY_DIR}/tm_basic_small.c)
endif()

target_include_directories(app PRIVATE ${TM_SRC})
target_sources(app PRIVATE src/tm_porting_layer_l1306.c ${TM_TEST_C})
target_compile_definitions(app PRIVATE TM_TEST_DURATION=${TM_DURATION}
  TM_TEST_NUM_THREADS=${TM_THREADS_${TM_TEST}} TM_TEST_STACK_SIZE=${TM_STACK})
```

## prj.conf
```kconfig
# Thread-Metric on the LP-MSPM0L1306 (4 KB RAM). Zephyr's own prj.conf, plus the memory fixes.
CONFIG_TICKLESS_KERNEL=y
CONFIG_SYS_CLOCK_TICKS_PER_SEC=100
CONFIG_SPEED_OPTIMIZATIONS=y
CONFIG_TIMESLICING=n
CONFIG_MP_MAX_NUM_CPUS=1
CONFIG_HW_STACK_PROTECTION=n
CONFIG_PICOLIBC_SPEED_OPTIMIZATIONS=y
CONFIG_PICOLIBC_USE_MODULE=y
CONFIG_THREAD_LOCAL_STORAGE=n
CONFIG_MEM_SLAB_POINTER_VALIDATE=n
CONFIG_MPU=n
CONFIG_ARM_MPU=n
# Added for 4 KB of RAM.
# No C library heap (the default takes all RAM left, and faults at boot when 16 bytes are left).
CONFIG_COMMON_LIBC_MALLOC_ARENA_SIZE=0
# Zephyr's default interrupt stack is 2,048 bytes.
CONFIG_ISR_STACK_SIZE=512
CONFIG_MAIN_STACK_SIZE=768
# The porting layer prints how much of each stack was used.
CONFIG_INIT_STACKS=y
CONFIG_THREAD_STACK_INFO=y
# The interrupt tests need a software-triggered interrupt.
CONFIG_IRQ_OFFLOAD=y
```

## irq.conf
```kconfig
# irq_offload() needs CONFIG_TEST (Zephyr's own Kconfig selects it for these two tests).
CONFIG_TEST=y
```

## src/tm_porting_layer_l1306.c
```c
/*
 * Thread-Metric porting layer for Zephyr, sized for 4 KB of RAM.
 * Derived from Zephyr's tests/benchmarks/thread_metric/src/tm_porting_layer_zephyr.c
 * (Copyright (c) 2024 Microsoft Corporation, Intel Corporation; MIT license).
 * Changes: thread count and stack size come from the build (TM_TEST_NUM_THREADS, TM_TEST_STACK_SIZE),
 * one semaphore, one queue, one slab of two blocks (no test uses more), and each reporting period
 * prints unused stack bytes (lines starting "S,") before the test prints its own result.
 */
#include "tm_api.h"

#include <stdio.h>
#include <zephyr/kernel.h>
#include <zephyr/irq_offload.h>

/* Kernel internals, declared here the same way mcu-bench-l1306 does (the header is private). */
extern struct k_thread z_idle_threads[];
K_KERNEL_STACK_ARRAY_DECLARE(z_interrupt_stacks, CONFIG_MP_MAX_NUM_CPUS, CONFIG_ISR_STACK_SIZE);
int z_stack_space_get(const uint8_t *stack_start, size_t size, size_t *unused_ptr);

#if (CONFIG_MP_MAX_NUM_CPUS > 1)
#error "*** Tests are only designed for single processor systems! ***"
#endif

static struct k_thread test_thread[TM_TEST_NUM_THREADS];
static K_THREAD_STACK_ARRAY_DEFINE(test_stack, TM_TEST_NUM_THREADS, TM_TEST_STACK_SIZE);
static struct k_sem test_sem[1];
static struct k_msgq test_msgq[1];
static char test_msgq_buffer[8][16];
static struct k_mem_slab test_slab[1];
static char __aligned(4) test_slab_buffer[2 * 128];

void tm_initialize(void (*test_initialization_function)(void))
{
	test_initialization_function();
}

int tm_thread_create(int thread_id, int priority, void (*entry_function)(void *, void *, void *))
{
	k_tid_t tid;

	tid = k_thread_create(&test_thread[thread_id], test_stack[thread_id],
			      TM_TEST_STACK_SIZE, entry_function,
			      NULL, NULL, NULL, priority, 0, K_FOREVER);
	k_thread_suspend(&test_thread[thread_id]);
	k_wakeup(&test_thread[thread_id]);
	return (tid == &test_thread[thread_id]) ? TM_SUCCESS : TM_ERROR;
}

int tm_thread_resume(int thread_id)
{
	k_thread_resume(&test_thread[thread_id]);
	return TM_SUCCESS;
}

int tm_thread_suspend(int thread_id)
{
	k_thread_suspend(&test_thread[thread_id]);
	return TM_SUCCESS;
}

void tm_thread_relinquish(void)
{
	k_yield();
}

static void print_stacks(void)
{
	size_t unused;
	int i;

	for (i = 0; i < TM_TEST_NUM_THREADS; i++) {
		if (k_thread_stack_space_get(&test_thread[i], &unused) == 0) {
			printf("S,test_thread_%d_unused_of_%d,%u\n", i, TM_TEST_STACK_SIZE,
			       (unsigned int)unused);
		}
	}
	k_thread_stack_space_get(k_current_get(), &unused);
	printf("S,main_unused_of_%d,%u\n", CONFIG_MAIN_STACK_SIZE, (unsigned int)unused);
	z_stack_space_get(K_KERNEL_STACK_BUFFER(z_interrupt_stacks[0]),
			  K_KERNEL_STACK_SIZEOF(z_interrupt_stacks[0]), &unused);
	printf("S,isr_unused_of_%d,%u\n", CONFIG_ISR_STACK_SIZE, (unsigned int)unused);
	k_thread_stack_space_get(&z_idle_threads[0], &unused);
	printf("S,idle_unused_of_%d,%u\n", CONFIG_IDLE_STACK_SIZE, (unsigned int)unused);
}

/* Called by each test's reporting loop (on the main thread) once per period. */
void tm_thread_sleep(int seconds)
{
	k_sleep(K_SECONDS(seconds));
	print_stacks();
}

int tm_queue_create(int queue_id)
{
	k_msgq_init(&test_msgq[0], &test_msgq_buffer[0][0], 16, 8);
	return TM_SUCCESS;
}

int tm_queue_send(int queue_id, unsigned long *message_ptr)
{
	return k_msgq_put(&test_msgq[0], message_ptr, K_FOREVER);
}

int tm_queue_receive(int queue_id, unsigned long *message_ptr)
{
	return k_msgq_get(&test_msgq[0], message_ptr, K_FOREVER);
}

int tm_semaphore_create(int semaphore_id)
{
	return k_sem_init(&test_sem[0], 1, 1);
}

int tm_semaphore_get(int semaphore_id)
{
	return k_sem_take(&test_sem[0], K_NO_WAIT);
}

int tm_semaphore_put(int semaphore_id)
{
	k_sem_give(&test_sem[0]);
	return TM_SUCCESS;
}

extern void tm_interrupt_handler(const void *);

void tm_cause_interrupt(void)
{
	irq_offload(tm_interrupt_handler, NULL);
}

int tm_memory_pool_create(int pool_id)
{
	return (k_mem_slab_init(&test_slab[0], &test_slab_buffer[0], 128, 2) == 0) ? TM_SUCCESS : TM_ERROR;
}

int tm_memory_pool_allocate(int pool_id, unsigned char **memory_ptr)
{
	return (k_mem_slab_alloc(&test_slab[0], (void **)memory_ptr, K_NO_WAIT) == 0) ? TM_SUCCESS : TM_ERROR;
}

int tm_memory_pool_deallocate(int pool_id, unsigned char *memory_ptr)
{
	k_mem_slab_free(&test_slab[0], (void *)memory_ptr);
	return TM_SUCCESS;
}
```
