// @cliArgs --board /ti/boards/LP_EM_CC2755P10 --rtos nortos
// uLisp on the LP-EM-CC2755P10: two LEDs (red DIO16, green DIO12) and the back-channel UART with a 512-byte receive ring.
var Power = scripting.addModule("/ti/drivers/Power");

system.getScript("kernel_config_release.syscfg.js");

var GPIO = scripting.addModule("/ti/drivers/GPIO");
var gpio0 = GPIO.addInstance();
gpio0.$hardware = system.deviceData.board.components.LED0;
gpio0.$name = "CONFIG_GPIO_LED_0";
var gpio1 = GPIO.addInstance();
gpio1.$hardware = system.deviceData.board.components.LED1;
gpio1.$name = "CONFIG_GPIO_LED_1";

var UART2 = scripting.addModule("/ti/drivers/UART2");
var uart2 = UART2.addInstance();
uart2.$hardware = system.deviceData.board.components.XDS110UART;
uart2.$name = "CONFIG_UART2_0";
uart2.rxRingBufferSize = 512;
