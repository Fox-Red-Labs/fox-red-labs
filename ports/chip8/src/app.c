/* CHIP-8 front end for the touch-games display layer (hal.h). The 64 x 32 screen is drawn at 5x (320 x 160) at the top,
 * a ROM bar below it (touch the left half for the previous ROM, the right half for the next) and a 4 x 4 key pad at the bottom.
 * Sound is not produced: the sound timer runs and nothing is played. */
#include "gfx.h"
#include "chip8.h"
#include "roms.h"          /* generated by build.sh: rom_names[], rom_data[], rom_len[], ROM_COUNT */

#ifndef BOOT_ROM
#define BOOT_ROM 0
#endif
#ifndef STEPS_PER_FRAME
#define STEPS_PER_FRAME 12      /* about 720 instructions per second, the usual CHIP-8 pace */
#endif
#ifndef AUTO_PLATFORM
#define AUTO_PLATFORM 1         /* 1: the quirks test starts with the CHIP-8 platform already chosen (its automation byte at 0x1FF) */
#endif
#ifndef BENCH
#define BENCH 1
#endif
#define SCALE 5
#define BAR_Y 160
#define BAR_H 40
#define PAD_Y 200
#define KEY_W 80
#define KEY_H 70
static const uint8_t keymap[16] = { 1, 2, 3, 0xC, 4, 5, 6, 0xD, 7, 8, 9, 0xE, 0xA, 0, 0xB, 0xF };   /* the COSMAC keypad layout */
static const char hexch[] = "0123456789ABCDEF";

static chip8_t c8;
static int cur_rom;
static const uint16_t C_ON = RGB(255, 255, 255), C_OFF = RGB(0, 0, 0), C_BG = RGB(30, 30, 34), C_KEY = RGB(60, 62, 70), C_HOT = RGB(180, 36, 24);

struct { uint32_t magic, rom, frames, steps, core_us, draw_us, last_draw_us, ips, touch_fail, touches; uint32_t ips_rom[ROM_COUNT]; } c8_stats;

static void draw_rows(uint32_t mask)
{
    for (int r = 0; r < C8_H; r++) {
        if (!(mask & (1u << r))) continue;
        uint16_t *p = gfx_buf;
        for (int sy = 0; sy < SCALE; sy++)
            for (int x = 0; x < C8_W; x++) { uint16_t v = c8.fb[r * C8_W + x] ? C_ON : C_OFF; for (int sx = 0; sx < SCALE; sx++) *p++ = v; }
        gfx_blit(0, r * SCALE, C8_W * SCALE, SCALE, gfx_buf);
    }
}
static void draw_key(int i, int hot)
{
    int cx = (i % 4) * KEY_W, cy = PAD_Y + (i / 4) * KEY_H; char s[2] = { hexch[keymap[i]], 0 };
    gfx_fill(cx + 2, cy + 2, KEY_W - 4, KEY_H - 4, hot ? C_HOT : C_KEY);
    gfx_text(cx + KEY_W / 2 - 9, cy + KEY_H / 2 - 14, s, 4, C_ON, hot ? C_HOT : C_KEY);
}
static void draw_bar(void)
{
    gfx_fill(0, BAR_Y, LCD_W, BAR_H, C_BG);
    gfx_text(8, BAR_Y + 12, "<", 3, C_ON, C_BG);
    gfx_text(LCD_W - 24, BAR_Y + 12, ">", 3, C_ON, C_BG);
    gfx_text_center(30, BAR_Y + 14, LCD_W - 60, rom_names[cur_rom], 2, C_ON, C_BG);
}
static void load_rom(int n)
{
    cur_rom = (n + ROM_COUNT) % ROM_COUNT; c8_stats.rom = (uint32_t)cur_rom;
    c8_reset(&c8, &c8_quirks_vip); c8_load(&c8, rom_data[cur_rom], rom_len[cur_rom]);
    if (AUTO_PLATFORM && rom_names[cur_rom][0] == '5') c8.mem[0x1FF] = 1;
    gfx_fill(0, 0, LCD_W, BAR_Y, C_OFF); c8.dirty = 0; draw_bar();
}

static void log_num(const char *k, uint32_t v) { char b[12]; hal_log(k); hal_log(gfx_utoa(v, b)); hal_log("\r\n"); }

/* Instruction rate, without the screen: each ROM's first 300 frames at 12 instructions per frame is not a fair rate (the display wait stalls),
 * so run the core flat out: 200,000 steps with the 60 Hz tick every 12 steps and the display wait off, and time them. */
static void bench(void)
{
    for (int n = 0; n < ROM_COUNT; n++) {
        c8_quirks_t q = c8_quirks_vip; q.disp_wait = 0;
        c8_reset(&c8, &q); c8_load(&c8, rom_data[n], rom_len[n]);
        uint32_t t0 = hal_us(); int f = 0;
        while (c8.steps < 200000 && f < 100000) { c8_frame(&c8, 12); f++; }
        uint32_t dt = hal_us() - t0;
        c8_stats.ips_rom[n] = (uint32_t)(((uint64_t)c8.steps * 1000000u) / (dt ? dt : 1));
        hal_log(rom_names[n]); hal_log(" ips "); char b[12]; hal_log(gfx_utoa(c8_stats.ips_rom[n], b)); hal_log("\r\n");
    }
}

int main_app(void)
{
    hal_init();
    hal_log("\r\n" BUILD_NAME ": starting\r\n");
    gfx_fill(0, 0, LCD_W, LCD_H, C_BG);
#if BENCH
    bench();
#endif
    c8_stats.magic = 0xC8C80001;
    gfx_fill(0, 0, LCD_W, LCD_H, C_BG);
    for (int i = 0; i < 16; i++) draw_key(i, 0);
    load_rom(BOOT_ROM);
    int held = -1, bar_lock = 0;
    uint32_t next = hal_ms();
    for (;;) {
        uint32_t now = hal_ms();
        if ((int32_t)(now - next) < 0) { hal_idle(); continue; }
        next += 16; if ((int32_t)(now - next) > 100) next = now + 16;     /* 60 Hz, 16 ms is close enough (62.5 Hz) */
        int x = 0, y = 0, d = hal_touch(&x, &y);
        c8_stats.touches += d > 0;
        if (d < 0) { c8_stats.touch_fail++; d = held >= 0 || bar_lock ? 1 : 0; x = y = 0; }
        int hit = -1;
        if (d > 0) {
            if (y >= PAD_Y && y < PAD_Y + 4 * KEY_H) hit = (y - PAD_Y) / KEY_H * 4 + x / KEY_W;
            else if (y >= BAR_Y && y < BAR_Y + BAR_H && !bar_lock) { bar_lock = 1; load_rom(cur_rom + (x < LCD_W / 2 ? -1 : 1)); }
        } else bar_lock = 0;
        if (hit != held) {
            if (held >= 0) { c8.key[keymap[held]] = 0; draw_key(held, 0); }
            if (hit >= 0) { c8.key[keymap[hit]] = 1; draw_key(hit, 1); }
            held = hit;
        }
        uint32_t t0 = hal_us(); uint32_t s0 = c8.steps;
        c8_frame(&c8, STEPS_PER_FRAME);
        uint32_t t1 = hal_us();
        c8_stats.core_us += t1 - t0; c8_stats.steps += c8.steps - s0; c8_stats.frames++;
        if (c8.dirty) { uint32_t m = c8.dirty; c8.dirty = 0; draw_rows(m); c8_stats.last_draw_us = hal_us() - t1; c8_stats.draw_us += c8_stats.last_draw_us; }
    }
}
