/*
 * Port of MaJerle/stm32-usart-uart-dma-rx-tx
 * projects/usart_rx_idle_line_irq_ringbuff_tx_G0 to LP-MSPM0G3519 (MSPM0 SDK, DriverLib).
 *
 * Same structure as the original: UART RX through DMA into a raw buffer,
 * a "check" routine run from interrupts that moves new bytes into an lwrb ring buffer,
 * a TX ring buffer sent out with DMA, and a 5-byte packet parser in the main loop.
 *
 * Differences from the STM32 original (see migration-report.md):
 * - USART IDLE line interrupt does not exist. A 1 ms SysTick calls the RX check instead.
 * - DMA half-transfer interrupt is the DMA "early interrupt" threshold (HALF).
 * - Clock stays at the SysConfig default (32 MHz); the original ran the core at 64 MHz.
 */

/* Includes */
#include <stdint.h>
#include <stdlib.h>
#include <string.h>

#include "lwrb/lwrb.h"
#include "ti_msp_dl_config.h"

/* Baud rate, single build-time define (makefile: -DUSART_BAUD=115200) */
#ifndef USART_BAUD
#define USART_BAUD              115200U
#endif

/* Idle detection period: the UART has no IDLE line event usable with DMA (see usart_init) */
#ifndef USART_IDLE_POLL_HZ
#define USART_IDLE_POLL_HZ      1000U
#endif

/* USART related functions */
void    usart_init(void);
void    usart_rx_check(void);
void    usart_process_data(const void* data, size_t len);
void    usart_send_string(const char* str);
uint8_t usart_start_tx_dma_transfer(void);

/**
 * \brief           Calculate length of statically allocated array
 */
#define ARRAY_LEN(x)            (sizeof(x) / sizeof((x)[0]))

/**
 * \brief           USART RX buffer for DMA to transfer every received byte RX
 * \note            Contains raw data that are about to be processed by different events
 */
uint8_t
usart_rx_dma_buffer[64];

/**
 * \brief           Ring buffer instance for RX data
 */
lwrb_t
usart_rx_rb;

/**
 * \brief           Ring buffer data array for RX DMA
 */
uint8_t
usart_rx_rb_data[128];

/**
 * \brief           Ring buffer instance for TX data
 */
lwrb_t
usart_tx_rb;

/**
 * \brief           Ring buffer data array for TX DMA
 */
uint8_t
usart_tx_rb_data[128];

/**
 * \brief           Length of currently active TX DMA transfer
 */
volatile size_t
usart_tx_dma_current_len;

/**
 * \brief           Application entry point
 */
int
main(void) {
    uint8_t state, cmd, len;

    /* Clocks, pins, UART, DMA channels as generated by SysConfig */
    SYSCFG_DL_init();

    /* Initialize ringbuff for TX & RX */
    lwrb_init(&usart_tx_rb, usart_tx_rb_data, sizeof(usart_tx_rb_data));
    lwrb_init(&usart_rx_rb, usart_rx_rb_data, sizeof(usart_rx_rb_data));

    /* Initialize all configured peripherals */
    usart_init();
    usart_send_string("USART DMA example: DMA HT & TC + USART IDLE LINE interrupts\r\n");
    usart_send_string("Start sending data to STM32\r\n");

    /* After this point, do not use usart_send_string function anymore */
    /* Send packet data over UART from PC (or other device) */

    /* Infinite loop */
    state = 0;
    while (1) {
        uint8_t b;

        /* Process RX ringbuffer */

        /* Packet format: START_BYTE, CMD, LEN[, DATA[0], DATA[len - 1]], STOP BYTE */
        /* DATA bytes are included only if LEN > 0 */
        /* An example, send sequence of these bytes: 0x55, 0x01, 0x01, 0xFF, 0xAA */

        /* Read byte by byte */

        if (lwrb_read(&usart_rx_rb, &b, 1) == 1) {
            switch (state) {
                case 0: {           /* Wait for start byte */
                    if (b == 0x55) {
                        ++state;
                    }
                    break;
                }
                case 1: {           /* Check packet command */
                    cmd = b;
                    ++state;
                    break;
                }
                case 2: {           /* Packet data length */
                    len = b;
                    ++state;
                    if (len == 0) {
                        ++state;    /* Ignore data part if len = 0 */
                    }
                    break;
                }
                case 3: {           /* Data for command */
                    --len;          /* Decrease for received character */
                    if (len == 0) {
                        ++state;
                    }
                    break;
                }
                case 4: {           /* End of packet */
                    if (b == 0xAA) {
                        /* Packet is valid */

                        /* Send out response with CMD = 0xFF */
                        b = 0x55;   /* Start byte */
                        lwrb_write(&usart_tx_rb, &b, 1);
                        cmd = 0xFF; /* Command = 0xFF = OK response */
                        lwrb_write(&usart_tx_rb, &cmd, 1);
                        b = 0x00;   /* Len = 0 */
                        lwrb_write(&usart_tx_rb, &b, 1);
                        b = 0xAA;   /* Stop byte */
                        lwrb_write(&usart_tx_rb, &b, 1);

                        /* Flush everything */
                        usart_start_tx_dma_transfer();
                    }
                    state = 0;
                    break;
                }
            }
        }

        /* Do other tasks ... */
    }
}

/**
 * \brief           Check for new data received with DMA
 *
 * User must select context to call this function from:
 * - Only interrupts (DMA early/done, SysTick) with same preemption priority level
 * - Only thread context (outside interrupts)
 *
 * If called from both context-es, exclusive access protection must be implemented
 * This mode is not advised as it usually means architecture design problems
 *
 * Not doing reads fast enough may cause DMA to overflow unread received bytes,
 * hence application will lost useful data.
 */
void
usart_rx_check(void) {
    static size_t old_pos;
    size_t pos;

    /* Calculate current position in buffer and check for new data available */
    pos = ARRAY_LEN(usart_rx_dma_buffer) - DL_DMA_getTransferSize(DMA, DMA_CH_RX_CHAN_ID);
    if (pos != old_pos) {                       /* Check change in received data */
        if (pos > old_pos) {                    /* Current position is over previous one */
            /* Processing is done in "linear" mode: single block, len = pos - old_pos */
            usart_process_data(&usart_rx_dma_buffer[old_pos], pos - old_pos);
        } else {
            /*
             * Processing is done in "overflow" mode..
             * Application must process data twice, since there are 2 linear memory blocks:
             * first [old_pos, N), then [0, pos)
             */
            usart_process_data(&usart_rx_dma_buffer[old_pos], ARRAY_LEN(usart_rx_dma_buffer) - old_pos);
            if (pos > 0) {
                usart_process_data(&usart_rx_dma_buffer[0], pos);
            }
        }
        old_pos = pos;                          /* Save current position as old for next transfers */
    }
}

/**
 * \brief           Check if DMA is active and if not try to send data
 * \return          `1` if transfer just started, `0` if on-going or no data to transmit
 */
uint8_t
usart_start_tx_dma_transfer(void) {
    uint32_t primask;
    uint8_t started = 0;

    /*
     * Transfer is in-active when usart_tx_dma_current_len == 0.
     * The variable is set before the DMA transfer is started and cleared in the DMA done interrupt.
     * This example assumes worst use case scenario, hence interrupts are disabled prior every check.
     */
    primask = __get_PRIMASK();
    __disable_irq();
    if (usart_tx_dma_current_len == 0
            && (usart_tx_dma_current_len = lwrb_get_linear_block_read_length(&usart_tx_rb)) > 0) {
        /* Disable channel if enabled */
        DL_DMA_disableChannel(DMA, DMA_CH_TX_CHAN_ID);

        /* Prepare DMA data and length */
        DL_DMA_setSrcAddr(DMA, DMA_CH_TX_CHAN_ID, (uint32_t) lwrb_get_linear_block_read_address(&usart_tx_rb));
        DL_DMA_setTransferSize(DMA, DMA_CH_TX_CHAN_ID, (uint16_t) usart_tx_dma_current_len);

        /* Start transfer: the UART TX FIFO trigger starts moving bytes */
        DL_DMA_enableChannel(DMA, DMA_CH_TX_CHAN_ID);
        started = 1;
    }
    __set_PRIMASK(primask);
    return started;
}

/**
 * \brief           Process received data over UART
 * Data are written to RX ringbuffer for application processing at latter stage
 * \param[in]       data: Data to process
 * \param[in]       len: Length in units of bytes
 */
void
usart_process_data(const void* data, size_t len) {
    lwrb_write(&usart_rx_rb, data, len);  /* Write data to receive buffer */
}

/**
 * \brief           Send string over USART
 * \param[in]       str: String to send
 */
void
usart_send_string(const char* str) {
    lwrb_write(&usart_tx_rb, str, strlen(str));   /* Write data to transmit buffer */
    usart_start_tx_dma_transfer();
}

/**
 * \brief           UART0 + DMA runtime initialization (pins, clocks, channel modes come from SysConfig)
 */
void
usart_init(void) {
    /* Baud rate comes from the USART_BAUD build-time define, overriding the SysConfig value */
    DL_UART_Main_disable(UART_0_INST);
    DL_UART_Main_configBaudRate(UART_0_INST, UART_0_INST_FREQUENCY, USART_BAUD);
    DL_UART_Main_enable(UART_0_INST);

    /* USART RX DMA: UART RXDATA -> usart_rx_dma_buffer, repeat mode = circular */
    DL_DMA_setSrcAddr(DMA, DMA_CH_RX_CHAN_ID, (uint32_t) (&UART_0_INST->RXDATA));
    DL_DMA_setDestAddr(DMA, DMA_CH_RX_CHAN_ID, (uint32_t) usart_rx_dma_buffer);
    DL_DMA_setTransferSize(DMA, DMA_CH_RX_CHAN_ID, ARRAY_LEN(usart_rx_dma_buffer));

    /* USART TX DMA: memory -> UART TXDATA, source and length set per transfer */
    DL_DMA_setDestAddr(DMA, DMA_CH_TX_CHAN_ID, (uint32_t) (&UART_0_INST->TXDATA));

    /* DMA early interrupt at half of RX buffer (HT), done interrupt at the end (TC) */
    DL_DMA_Full_Ch_setEarlyInterruptThreshold(DMA, DMA_CH_RX_CHAN_ID, DL_DMA_EARLY_INTERRUPT_THRESHOLD_HALF);
    DL_DMA_enableInterrupt(DMA, DL_DMA_INTERRUPT_CHANNEL0 | DL_DMA_INTERRUPT_CHANNEL1);

    /* DMA and UART interrupts, same priority */
    NVIC_SetPriority(DMA_INT_IRQn, 0);
    NVIC_EnableIRQ(DMA_INT_IRQn);

    /*
     * Replacement for the USART IDLE line interrupt: the UART RX timeout flag only fires while bytes
     * wait in the RX FIFO, but the DMA empties the FIFO on every byte, so it never fires.
     * SysTick runs usart_rx_check() every 1/USART_IDLE_POLL_HZ s, at the same priority as the DMA irq.
     */
    NVIC_SetPriority(SysTick_IRQn, 0);
    SysTick_Config(CPUCLK_FREQ / USART_IDLE_POLL_HZ);

    /* Enable DMA RX */
    DL_DMA_enableChannel(DMA, DMA_CH_RX_CHAN_ID);
}

/* Interrupt handlers here */

/**
 * \brief           DMA interrupt handler: channel 0 = USART RX, channel 1 = USART TX
 */
void
DMA_IRQHandler(void) {
    DL_DMA_EVENT_IIDX iidx;

    /* Reading the pending index clears that event; loop until nothing is left */
    while ((iidx = DL_DMA_getPendingInterrupt(DMA)) != DL_DMA_EVENT_IIDX_NO_INTR) {
        switch (iidx) {
            case DL_DMA_EVENT_IIDX_DMACH0:      /* RX early (half) and done (complete) */
                usart_rx_check();               /* Check for data to process */
                break;
            case DL_DMA_EVENT_IIDX_DMACH1:      /* TX done */
                lwrb_skip(&usart_tx_rb, usart_tx_dma_current_len);  /* Skip sent data, mark as read */
                usart_tx_dma_current_len = 0;   /* Clear length variable */
                usart_start_tx_dma_transfer();  /* Start sending more data */
                break;
            default:
                break;
        }
    }
}

/**
 * \brief           SysTick handler, stands in for the USART IDLE line interrupt
 */
void
SysTick_Handler(void) {
    usart_rx_check();                           /* Check for data to process */
}
