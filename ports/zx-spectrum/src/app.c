/* ZX Spectrum front end for the touch-games display layer (hal.h): the 256 x 192 screen at 1:1 on top, a 40-key touch keyboard below.
 * The machine runs flat out (no 50 Hz pacing) so the speed is measured, not hidden; the log reports it. Silent: the beeper is not emulated. */
#include "gfx.h"
#include "zx.h"
#include "rom.h"            /* generated by build.sh: zx_rom[16384] */

#ifndef BENCH_LOG_FRAMES
#define BENCH_LOG_FRAMES 100
#endif
#ifndef STOP_AFTER_FRAMES
#define STOP_AFTER_FRAMES 0   /* nonzero: stop at a frame boundary after this many frames (for the frame-buffer comparison) */
#endif
#define SCR_X 32
#define SCR_Y 12
#define KB_Y 224
#define KEY_W 32
#define KEY_H 60
static const char *const hrs[8] = { "^ZXCV", "ASDFG", "QWERT", "12345", "09876", "POIUY", "=LKJH", "_#MNB" };
static const char *const grid[4] = { "1234567890", "QWERTYUIOP", "ASDFGHJKL=", "^ZXCVBNM#_" };
static const uint16_t C_BG = RGB(30, 30, 34), C_KEY = RGB(60, 62, 70), C_HOT = RGB(180, 36, 24), C_TXT = RGB(255, 255, 255);

static zx_t zx;
static uint8_t shadow[6912];
static uint8_t flash_phase;
struct { uint32_t magic, frames, core_us, draw_us, bands, touches, touch_fail, pct_core_x10, pct_total_x10, last_band_us; } zx_stats;

static void key_xy(char ch, int *hr, int *bit)
{
    for (int r = 0; r < 8; r++) for (int b = 0; b < 5; b++) if (hrs[r][b] == ch) { *hr = r; *bit = b; return; }
    *hr = -1; *bit = 0;
}
static const char *key_label(char ch, char *tmp)
{
    if (ch == '^') return "CAP"; if (ch == '#') return "SYM"; if (ch == '_') return "SPC"; if (ch == '=') return "ENT";
    tmp[0] = ch; tmp[1] = 0; return tmp;
}
static void draw_key(int r, int c, int hot)
{
    char tmp[2], ch = grid[r][c]; const char *s = key_label(ch, tmp); int big = tmp[0] == ch && s == tmp;
    int x = c * KEY_W, y = KB_Y + r * KEY_H; uint16_t bg = hot ? C_HOT : C_KEY;
    gfx_fill(x + 1, y + 1, KEY_W - 2, KEY_H - 2, bg);
    int sc = big ? 3 : 1;
    gfx_text(x + (KEY_W - gfx_text_w(s, sc)) / 2, y + (KEY_H - 7 * sc) / 2, s, sc, C_TXT, bg);
}
static void draw_border(void)
{
    uint16_t c = zx_border_rgb(zx.border);
    gfx_fill(0, 0, LCD_W, SCR_Y, c); gfx_fill(0, SCR_Y + 192, LCD_W, KB_Y - SCR_Y - 192, c);
    gfx_fill(0, SCR_Y, SCR_X, 192, c); gfx_fill(SCR_X + 256, SCR_Y, LCD_W - SCR_X - 256, 192, c);
}
static void log_stats(void)
{
    char b[12];
    hal_log("zx frames "); hal_log(gfx_utoa(zx_stats.frames, b));
    hal_log(" core_pct_x10 "); hal_log(gfx_utoa(zx_stats.pct_core_x10, b));
    hal_log(" total_pct_x10 "); hal_log(gfx_utoa(zx_stats.pct_total_x10, b));
    hal_log(" core_us "); hal_log(gfx_utoa(zx_stats.core_us, b));
    hal_log(" draw_us "); hal_log(gfx_utoa(zx_stats.draw_us, b)); hal_log("\r\n");
}
/* Redraw the character rows whose bitmap, attributes or flash phase changed since the last draw. */
static void draw_screen(int force)
{
    for (int band = 0; band < 24; band++) {
        int dirty = force, has_flash = 0;
        const uint8_t *at = &zx.ram[0x1800 + band * 32];
        for (int i = 0; i < 32; i++) has_flash |= at[i] >> 7;
        for (int line = 0; line < 8 && !dirty; line++) {
            int y = band * 8 + line; uint32_t off = ((y & 0xC0) << 5) | ((y & 7) << 8) | (((y >> 3) & 7) << 5);
            for (int i = 0; i < 32; i++) if (zx.ram[off + i] != shadow[off + i]) { dirty = 1; break; }
        }
        for (int i = 0; i < 32 && !dirty; i++) if (at[i] != shadow[0x1800 + band * 32 + i]) dirty = 1;
        if (has_flash && (zx.frames & 15) == 0) dirty = 1;
        if (!dirty) continue;
        uint32_t t0 = hal_us();
        zx_render_band(&zx, band, flash_phase, gfx_buf);
        gfx_blit(SCR_X, SCR_Y + band * 8, 256, 8, gfx_buf);
        for (int line = 0; line < 8; line++) {
            int y = band * 8 + line; uint32_t off = ((y & 0xC0) << 5) | ((y & 7) << 8) | (((y >> 3) & 7) << 5);
            for (int i = 0; i < 32; i++) shadow[off + i] = zx.ram[off + i];
        }
        for (int i = 0; i < 32; i++) shadow[0x1800 + band * 32 + i] = at[i];
        zx_stats.bands++; zx_stats.last_band_us = hal_us() - t0;
    }
}

int main_app(void)
{
    hal_init();
    hal_log("\r\n" BUILD_NAME ": starting\r\n");
    zx_init(&zx, zx_rom);
    gfx_fill(0, 0, LCD_W, LCD_H, C_BG);
    draw_border();
    for (int r = 0; r < 4; r++) for (int c = 0; c < 10; c++) draw_key(r, c, 0);
    zx_stats.magic = 0x5A580001;
    int held_r = -1, held_c = -1, hold_frames = 0, latched_caps = 0, latched_sym = 0, last_border = zx.border;
    uint32_t t_start = hal_us(), core_win = 0, win_start = t_start, win_frames = 0;
    for (;;) {
        uint32_t t0 = hal_us();
        zx_run_frame(&zx);
        uint32_t t1 = hal_us();
        zx_stats.core_us += t1 - t0; core_win += t1 - t0; win_frames++; zx_stats.frames = zx.frames;
        flash_phase = (zx.frames >> 4) & 1;
        /* touch: one read per frame; a key stays down while touched and for at least 3 frames */
        int x = 0, y = 0, d = hal_touch(&x, &y);
        zx_stats.touches += d > 0; if (d < 0) { zx_stats.touch_fail++; d = held_r >= 0; x = held_c * KEY_W + 1; y = KB_Y + held_r * KEY_H + 1; }
        int hr = -1, hc = -1;
        if (d > 0 && y >= KB_Y && y < KB_Y + 4 * KEY_H) { hr = (y - KB_Y) / KEY_H; hc = x / KEY_W; }
        if (hold_frames > 0) hold_frames--;
        if ((hr != held_r || hc != held_c) && hold_frames == 0) {
            if (held_r >= 0) {
                char ch = grid[held_r][held_c]; int a, b; key_xy(ch, &a, &b);
                if (ch != '^' && ch != '#') {
                    zx_key(&zx, a, b, 0);
                    if (latched_caps) { zx_key(&zx, 0, 0, 0); latched_caps = 0; draw_key(3, 0, 0); }
                    if (latched_sym)  { zx_key(&zx, 7, 1, 0); latched_sym = 0; draw_key(3, 8, 0); }
                }
                draw_key(held_r, held_c, (ch == '^' && latched_caps) || (ch == '#' && latched_sym));
            }
            if (hr >= 0) {
                char ch = grid[hr][hc]; int a, b; key_xy(ch, &a, &b);
                if (ch == '^') { latched_caps ^= 1; zx_key(&zx, 0, 0, latched_caps); }
                else if (ch == '#') { latched_sym ^= 1; zx_key(&zx, 7, 1, latched_sym); }
                else zx_key(&zx, a, b, 1);
                draw_key(hr, hc, 1); hold_frames = 3;
            }
            held_r = hr; held_c = hc;
        }
        if (zx.border != last_border) { last_border = zx.border; draw_border(); }
        uint32_t t2 = hal_us();
        draw_screen(0);
        zx_stats.draw_us += hal_us() - t2;
        if (win_frames >= BENCH_LOG_FRAMES) {
            uint32_t now = hal_us(), wall = now - win_start;
            uint64_t emu_us = (uint64_t)win_frames * 19968u;          /* a real 48K takes 19.968 ms per frame */
            zx_stats.pct_core_x10  = (uint32_t)(emu_us * 1000u / (core_win ? core_win : 1));
            zx_stats.pct_total_x10 = (uint32_t)(emu_us * 1000u / (wall ? wall : 1));
            log_stats();
            core_win = 0; win_frames = 0; win_start = hal_us();
        }
        if (STOP_AFTER_FRAMES && zx.frames >= STOP_AFTER_FRAMES) { hal_log("zx stopped\r\n"); for (;;) hal_idle(); }
    }
}
