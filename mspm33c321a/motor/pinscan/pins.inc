    {1, "nFAULT", IOMUX_PINCM67, GPIOB, DL_GPIO_PIN_30},
    {1, "nSLEEP", IOMUX_PINCM30, GPIOB, DL_GPIO_PIN_13},
    {1, "DRVOFF", IOMUX_PINCM65, GPIOB, DL_GPIO_PIN_28},
    {1, "ILIM", IOMUX_PINCM76, GPIOC, DL_GPIO_PIN_2},
    {1, "HALLC", IOMUX_PINCM80, GPIOC, DL_GPIO_PIN_21},
    {1, "HALLB", IOMUX_PINCM22, GPIOA, DL_GPIO_PIN_11},
    {1, "HALLA", IOMUX_PINCM21, GPIOA, DL_GPIO_PIN_10},
    {1, "INLC", IOMUX_PINCM24, GPIOB, DL_GPIO_PIN_7},
    {1, "INHC", IOMUX_PINCM23, GPIOB, DL_GPIO_PIN_6},
    {1, "INLB", IOMUX_PINCM72, GPIOC, DL_GPIO_PIN_19},
    {1, "INHB", IOMUX_PINCM71, GPIOC, DL_GPIO_PIN_18},
    {1, "INLA", IOMUX_PINCM94, GPIOC, DL_GPIO_PIN_29},
    {1, "INHA", IOMUX_PINCM70, GPIOC, DL_GPIO_PIN_17},
    {1, "ISENA", IOMUX_PINCM77, GPIOC, DL_GPIO_PIN_3},
    {1, "ISENB", IOMUX_PINCM78, GPIOC, DL_GPIO_PIN_4},
    {1, "ISENC", IOMUX_PINCM79, GPIOC, DL_GPIO_PIN_5},
    {1, "VM", IOMUX_PINCM39, GPIOA, DL_GPIO_PIN_17},
    {2, "nFAULT", IOMUX_PINCM64, GPIOC, DL_GPIO_PIN_15},
    {2, "nSLEEP", IOMUX_PINCM2, GPIOA, DL_GPIO_PIN_1},
    {2, "DRVOFF", IOMUX_PINCM7, GPIOA, DL_GPIO_PIN_2},
    {2, "ILIM", IOMUX_PINCM48, GPIOB, DL_GPIO_PIN_20},
    {2, "HALLC", IOMUX_PINCM91, GPIOC, DL_GPIO_PIN_26},
    {2, "HALLB", IOMUX_PINCM13, GPIOB, DL_GPIO_PIN_1},
    {2, "HALLA", IOMUX_PINCM12, GPIOB, DL_GPIO_PIN_0},
    {2, "INLC", IOMUX_PINCM15, GPIOB, DL_GPIO_PIN_2},
    {2, "INHC", IOMUX_PINCM16, GPIOB, DL_GPIO_PIN_3},
    {2, "INLB", IOMUX_PINCM17, GPIOB, DL_GPIO_PIN_4},
    {2, "INHB", IOMUX_PINCM18, GPIOB, DL_GPIO_PIN_5},
    {2, "INLA", IOMUX_PINCM19, GPIOA, DL_GPIO_PIN_8},
    {2, "INHA", IOMUX_PINCM20, GPIOA, DL_GPIO_PIN_9},
    {2, "ISENA", IOMUX_PINCM49, GPIOB, DL_GPIO_PIN_21},
    {2, "ISENB", IOMUX_PINCM51, GPIOB, DL_GPIO_PIN_23},
    {2, "ISENC", IOMUX_PINCM50, GPIOB, DL_GPIO_PIN_22},
    {2, "VM", IOMUX_PINCM55, GPIOA, DL_GPIO_PIN_25},
