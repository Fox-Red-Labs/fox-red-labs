## CMakeLists.txt
```
# CoreMark on Zephyr (E242 follow-up): EEMBC sources from $COREMARK_DIR, our timing port in port/. Not part of the repo's tree: fetch
# https://github.com/eembc/coremark and export COREMARK_DIR before west build.
cmake_minimum_required(VERSION 3.20.0)
find_package(Zephyr REQUIRED HINTS $ENV{ZEPHYR_BASE})
project(core1_coremark)
set(CM $ENV{COREMARK_DIR})
target_sources(app PRIVATE src/main.c ${CM}/core_list_join.c ${CM}/core_matrix.c ${CM}/core_state.c ${CM}/core_util.c
  ${CM}/core_main.c port/core_portme.c)
target_sources_ifdef(CONFIG_FRL_RING_CONSOLE app PRIVATE src/ring_console.c)
target_include_directories(app PRIVATE ${CM} port)
set_source_files_properties(${CM}/core_main.c PROPERTIES COMPILE_DEFINITIONS "main=coremark_main")
target_compile_definitions(app PRIVATE PERFORMANCE_RUN=1 ITERATIONS=${ITER} FLAGS_STR="-O2" MEM_METHOD=MEM_STATIC TOTAL_DATA_SIZE=2000 HAS_PRINTF=0 HAS_STDIO=0 MAIN_HAS_NOARGC=0)
```

## prj.conf
```kconfig
CONFIG_PRINTK=y
CONFIG_STDOUT_CONSOLE=n
CONFIG_SPEED_OPTIMIZATIONS=y
CONFIG_MAIN_STACK_SIZE=8192
CONFIG_CBPRINTF_FP_SUPPORT=y
```

## src/main.c
```c
/* CoreMark on the Zephyr core (core 1). Prints to the console ring. */
#include <zephyr/kernel.h>
#include <zephyr/sys/printk.h>
int coremark_main(int argc, char *argv[]);
int main(void)
{
	uint64_t f, mp, el;
	__asm__ volatile("mrs %0, cntfrq_el0" : "=r"(f));
	__asm__ volatile("mrs %0, mpidr_el1" : "=r"(mp));
	__asm__ volatile("mrs %0, CurrentEL" : "=r"(el));
	printk("coremark: MPIDR=0x%llx EL%llu cntfrq=%llu\n", (unsigned long long)mp, (unsigned long long)(el >> 2), (unsigned long long)f);
	char *argv[] = {"coremark", NULL};
	for (unsigned n = 0;; n++) {   /* repeat so a Linux run can overlap in time; the ring keeps the last reports */
		printk("coremark: pass %u\n", n);
		coremark_main(1, argv);
	}
	return 0;
}
```
